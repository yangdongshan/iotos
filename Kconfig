## Kconfig
```kconfig
mainmenu "iotOS Configuration"

menu "Build Setup"

choice
    prompt "Build Host platform"
    default LINUX_HOST

config LINUX_HOST
    bool "Linux"

config WIN_CYGWIN
    bool "Window Cygwin"

endchoice

config TOOLCHAIN
    string "build toolchain prefix"
    default "arm-none-eabi-"
    depends on LINUX_HOST
    ---help---
        Set build toolchain prefix, for example, x86_64-linux-gnu-
        for amd64, arm-none-eabi- for cortex-m*.

config COMPILE_OPTIMISE_LEVEL
    int "Compile optimize level"
    default 2
    ---help---
        Set to 0 identicals to set -O0 to CFLAGS
        Set to 1 identicals to set -O1 to CFLAGS
        Set to 2 identicals to set -O2 to CFLAGS
        Set to 3 identicals to set -O3 to CFLAGS
        Others, -Os


endmenu # Build Setup


menu "Kernel Configuartion"
source "kernel/Kconfig"
endmenu # Kernel Configuration

menu "Debug Options"
source "kernel/kdebug/Kconfig"
endmenu # Debug Options
```

## kernel/Kconfig
```kconfig
config BOOT_STACK_SIZE
    hex "boot stack size"
    default 0x400

config TICKS_PER_SEC
    int "ticks per second"
    default 100
    ---help---

menu "Task config"

config MAX_TASK_CNT
    int "max task count supported"
    default 32

endmenu

menu "Timer config"
config DYNAMIC_ALLOC_TIMER
    bool "dynamically allocate timer"
    default y

config PRE_ALLOC_TIMER_CNT
    int "pre-allocate timer cnt"
    default 1
    depends on DYNAMIC_ALLOC_TIMER

endmenu

menu "Semphore config"

config PRE_ALLOC_HOLDER_CNT
    int "pre-allocate semphore holder cnt"
    default 32

config DYNAMIC_ALLOC_HOLDER
    bool "dynamically allocate semphore holder"
    default y

endmenu


choice
    prompt "mm debug level"
    default MM_DEBUG_ERROR

config MM_DEBUG_ERROR
    bool "enable kernel mm error msg"

config MM_DEBUG_DEBUG
    bool "enalbe kernel mm debug msg"

config MM_DEBUG_INFO
    bool "enable kernel mm info msg"

config MM_DEBUG_NONE
    bool "disable kernel mm msg"

endchoice
```

## kernel/kdebug/Kconfig
```kconfig
config KERNEL_DEBUG
    bool "kernel debug Configuartion"
    default y

if KERNEL_DEBUG
choice
    prompt "kernel debug level"
    default KERNEL_DEBUG_LEVEL_DEBUG
    depends on KERNEL_DEBUG

config KERNEL_DEBUG_LEVEL_ERR
    bool "kernel debug level err"

config KERNEL_DEBUG_LEVEL_WARN
    bool "kernel debug level warning"

config KERNEL_DEBUG_LEVEL_INFO
    bool "kernel debug level info"

config KERNEL_DEBUG_LEVEL_DEBUG
    bool "kernel debug level debug"
endchoice

endif

config KERNEL_ASSERT
    bool "kernel assert"
    default y
    ---help---
        Enable or disable debug assertion
```
